## conf/distro/iaca-os.conf
```bitbake
# IACA OS Distribution Configuration
# This file defines the iaca-os distribution

# Distro identification
DISTRO = "iaca-os"
DISTRO_NAME = "IACA OS"
DISTRO_VERSION = "1.0"
DISTRO_CODENAME = "scarthgap"

# Distro basic
TARGET_VENDOR = "-iaca"
MAINTAINER = "Julien FAURE <julien.faure@iaca-electronique.com>"
TCLIBCAPPEND = ""

# Kernel and hardware support
ENABLE_I2C = "1"
KERNEL_MODULE_AUTOLOAD += " i2c-dev i2c-bcm2708 i2c-designware-core"

# Rust configuration
PREFERRED_VERSION_linux-raspberrypi = "6.12.%"
RUST_KERNEL_TOOLCHAIN ?= "${HOME}/.rustup/toolchains/1.78.0-x86_64-unknown-linux-gnu"
RUST_KERNEL_BINDGEN_DIR ?= "${HOME}/rust-kernel-tools/bin"

# Init system
INIT_MANAGER ?= "sysvinit"

# Initramfs
INITRAMFS_IMAGE_BUNDLE ?= "1"
INITRAMFS_IMAGE ?= "overlay-initramfs-image"
INITRAMFS_IMAGE_NAME ?= "${INITRAMFS_IMAGE}-${MACHINE}.rootfs"
```
